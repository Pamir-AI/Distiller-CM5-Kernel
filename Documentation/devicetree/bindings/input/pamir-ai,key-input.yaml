## Documentation/devicetree/bindings/input/pamir-ai,key-input.yaml
```yaml
# SPDX-License-Identifier: (GPL-2.0-only OR BSD-2-Clause)
%YAML 1.2
---
$id: http://devicetree.org/schemas/input/pamir-ai,key-input.yaml#
$schema: http://devicetree.org/meta-schemas/core.yaml#

title: Pamir AI Key Input Driver

maintainers:
  - Utsav Balar <utsavbalar1231@gmail.com>

description: |
  The Pamir AI Key Input driver interfaces with a microcontroller (typically an RP2040)
  over UART. It processes button state information from the microcontroller and exposes
  the buttons as input events to the Linux input subsystem. It also provides a bidirectional
  UART communication interface accessible from userspace via a character device.
  
  The driver supports both a line-based protocol (where each line contains a decimal
  number representing button state) and a raw protocol (where each byte directly represents
  button state).

properties:
  compatible:
    const: pamir-ai,key-input

  debounce-interval-ms:
    description:
      Debounce interval in milliseconds to prevent multiple button
      events from being triggered due to physical button bounce.
    $ref: /schemas/types.yaml#/definitions/uint32
    default: 50

  raw-protocol:
    description:
      Use raw protocol instead of line-based protocol. In raw protocol mode,
      each byte directly represents a button state (values 0-15 valid).
    type: boolean

  report-press-only:
    description:
      Only report button press events, not release events. When a button is
      released, the driver will immediately send a release event to ensure
      the key doesn't "stick".
    type: boolean

  recovery-timeout-ms:
    description:
      Timeout in milliseconds for UART recovery in case of communication errors.
    $ref: /schemas/types.yaml#/definitions/uint32
    default: 1000

required:
  - compatible

additionalProperties: false

examples:
  - |
    #include <dt-bindings/input/input.h>
    
    pamir_key_input: pamir-key-input {
        compatible = "pamir-ai,key-input";
        status = "okay";
        
        /* Optional configurations */
        debounce-interval-ms = <50>;
        raw-protocol;
        report-press-only;
        recovery-timeout-ms = <1000>;
    };
... 
```

## Documentation/devicetree/bindings/input/pamir-ai-keyinput.yaml
```yaml
# SPDX-License-Identifier: (GPL-2.0-only OR BSD-2-Clause)
%YAML 1.2
---
$id: http://devicetree.org/schemas/input/pamir-ai-keyinput.yaml#
$schema: http://devicetree.org/meta-schemas/core.yaml#

title: Pamir AI Key Input Device Tree Bindings

maintainers:
  - Utsav Balar <utsavbalar1231@gmail.com>

description: |
  This binding describes the Pamir AI Key Input overlay which enables a
  key input device connected via UART2 (ttyAMA2) to a RP2040 microcontroller.
  The key input device provides keyboard functionality for Pamir AI devices.

properties:
  compatible:
    const: pamir,key-input

  status:
    enum:
      - okay
      - disabled

  debounce-interval-ms:
    type: integer
    default: 50
    description: Debounce time in milliseconds for key presses

  raw-protocol:
    type: boolean
    description: Enable raw byte protocol mode for communication

  report-press-only:
    type: boolean
    description: Only report key press events, not releases

  recovery-timeout-ms:
    type: integer
    default: 1000
    description: Timeout in milliseconds for UART communication recovery

required:
  - compatible
  - status

additionalProperties: false

examples:
  - |
    / {
      fragment@0 {
        target = <&uart2>;
        __overlay__ {
          status = "okay";
          pinctrl-names = "default";
          pinctrl-0 = <&uart2_pins>;

          pamir_keyinput: pamir-keyinput {
            compatible = "pamir,key-input";
            status = "okay";
            debounce-interval-ms = <50>;
            raw-protocol;
            recovery-timeout-ms = <1000>;
          };
        };
      };
    }; 
```

## Documentation/devicetree/bindings/input/pamir-keyinput.txt
```
Pamir Key Input Driver
=====================

The Pamir Key Input driver provides support for button inputs from an RP2040 
microcontroller connected via UART2 (ttyAMA2) on a Raspberry Pi Compute Module 5.

Required properties:
- compatible: Must be "pamir,key-input"

Optional properties:
- debounce-interval-ms: Debounce time for button inputs in milliseconds (default: 50ms)
- poll-interval-ms: Polling interval for button press detection in milliseconds (default: 10ms)
- raw-protocol: Boolean flag. When present, enables raw protocol mode where each byte 
                received from UART is interpreted as a button state rather than parsing
                newline-terminated ASCII numbers. Default: disabled (use line protocol).
- report-press-only: Boolean flag. When present, only button press events are reported
                     to userspace, not release events. Default: disabled (report both).
- recovery-timeout-ms: UART recovery timeout in milliseconds (default: 1000ms)

The driver interprets button state bits according to the following mapping:
- Bit 0 (0b0001): UP button
- Bit 1 (0b0010): DOWN button
- Bit 2 (0b0100): SELECT button
- Bit 3 (0b1000): POWER button (shutdown request)

Example:
========

Example of device tree entry:

serdev: serial-controller {
	compatible = "linux,serdev-controller";
	#address-cells = <1>;
	#size-cells = <0>;
	serdev-device@0 {
		compatible = "pamir,key-input";
		reg = <0>;
		status = "okay";
		debounce-interval-ms = <50>;
		poll-interval-ms = <10>;
		/* raw-protocol; */
		/* report-press-only; */
		recovery-timeout-ms = <1000>;
	};
};

Example of device tree overlay usage:
=====================================

To enable the driver using the provided overlay, add the following to your config.txt:

dtoverlay=pamir-keyinput

With custom parameters:

dtoverlay=pamir-keyinput,debounce=100,poll_interval=20,raw_protocol=1,report_press_only=1 
```

## Documentation/devicetree/bindings/misc/pamir-ai,sam.yaml
```yaml
# SPDX-License-Identifier: (GPL-2.0-only OR BSD-2-Clause)
%YAML 1.2
---
$id: http://devicetree.org/schemas/misc/pamir-ai,sam.yaml#
$schema: http://devicetree.org/meta-schemas/core.yaml#

title: Pamir AI Ultra-Optimized UART Protocol Device

maintainers:
  - Pamir AI Team

description: |
  The Pamir AI SAM is an binary communication protocol for communication
  between a Linux host processor and an RP2040 microcontroller. It provides a 
  compact, reliable interface for buttons, LEDs, power management, and system 
  commands.

  The protocol uses a fixed-size 4-byte packet format with checksum validation
  to ensure reliable communication.

properties:
  compatible:
    const: pamir-ai,sam

  debug-level:
    description: |
      Controls verbosity of debug messages:
      0 = Minimal debugging (errors only)
      1 = Basic debugging (errors + important events)
      2 = Verbose debugging (all debug messages)
      3 = Ultra-verbose debugging (all debug messages + protocol details)
    type: integer
    minimum: 0
    maximum: 3
    default: 1

  ack-required:
    description: |
      If true, the driver will send an acknowledgment packet for each
      received packet (except button events). This improves reliability
      at the cost of increased traffic.
    type: boolean
    default: false

  recovery-timeout-ms:
    description: |
      Timeout in milliseconds for protocol recovery in case of communication
      errors. After this period without valid communication, the driver will
      attempt to reset the communication channel.
    type: integer
    minimum: 100
    maximum: 10000
    default: 1000

required:
  - compatible

examples:
  - |
    #include <dt-bindings/interrupt-controller/irq.h>

    serial@12340000 {
      compatible = "ns16550a";
      reg = <0x12340000 0x100>;
      interrupts = <GIC_SPI 68 IRQ_TYPE_LEVEL_HIGH>;
      clock-frequency = <5000000>;
      current-speed = <115200>;

      pamir_ai_sam: pamir-ai-sam {
        compatible = "pamir-ai,sam";
        debug-level = <1>;
        ack-required = <0>;
        recovery-timeout-ms = <1000>;
      };
    };

  - |
    # Example for Raspberry Pi CM5 with RP1 SoC

    serial@41000000 {
      compatible = "arm,pl011", "arm,primecell";
      reg = <0x41000000 0x1000>;
      interrupts = <GIC_SPI 16 IRQ_TYPE_LEVEL_HIGH>;
      clocks = <&rp1_clk RP1_CLK_UART>, <&rp1_clk RP1_CLK_PERI_SYS>;
      clock-names = "uartclk", "apb_pclk";
      current-speed = <115200>;
      status = "okay";

      pamir_ai_sam: pamir-ai-sam {
        compatible = "pamir-ai,sam";
        debug-level = <2>;
        ack-required = <1>;
        recovery-timeout-ms = <1500>;
      };
    };

  - |
    # Example for Raspberry Pi CM5 using BCM2835 auxiliary UART

    auxuart@41000000 {
      compatible = "brcm,bcm2835-aux-uart";
      reg = <0x41000000 0x40>;
      interrupts = <GIC_SPI 29 IRQ_TYPE_LEVEL_HIGH>;
      clocks = <&clocks BCM2835_CLOCK_UART>;
      status = "okay";
      
      pamir_ai_sam: pamir-ai-sam {
        compatible = "pamir-ai,sam";
        debug-level = <1>;
        ack-required = <0>;
        recovery-timeout-ms = <1000>;
      };
    };
```

## Documentation/devicetree/bindings/misc/pamir-ai-sam.yaml
```yaml
# SPDX-License-Identifier: (GPL-2.0-only OR BSD-2-Clause)
%YAML 1.2
---
$id: http://devicetree.org/schemas/misc/pamir-ai-sam.yaml#
$schema: http://devicetree.org/meta-schemas/core.yaml#

title: Pamir AI Sensor and Actuator Module (SAM) Device Tree Bindings

maintainers:
  - Utsav Balar <utsavbalar1231@gmail.com>

description: |
  This binding describes the Pamir AI Sensor and Actuator Module (SAM) overlay which
  enables communication between the host processor and an RP2040 microcontroller
  providing interface to sensor inputs and actuator outputs on CM5 devices.
  
  The SAM module communicates over UART and provides an input interface for buttons,
  as well as LED control functionality. It also provides a character device interface
  for user-space applications.

properties:
  compatible:
    const: pamir-ai,sam

  status:
    enum:
      - okay
      - disabled

  debug-level:
    type: integer
    default: 1
    description: |
      Debug verbosity level:
      0 - No debug messages
      1 - Basic operational messages
      2 - Detailed debug information
      3 - Very verbose debugging including packet dumps

  recovery-timeout-ms:
    type: integer
    default: 1000
    description: Timeout in milliseconds for UART communication recovery

  ack-required:
    type: boolean
    description: Require acknowledgement packets for each command sent

required:
  - compatible
  - status

additionalProperties: false

examples:
  - |
    / {
      fragment@0 {
        target = <&uart0>;
        __overlay__ {
          status = "okay";
          pinctrl-names = "default";
          pinctrl-0 = <&uart0_pins>;
        };
      };

      fragment@1 {
        target = <&uart0>;
        __overlay__ {
          pamir_ai_sam: pamir-ai-sam {
            compatible = "pamir-ai,sam";
            status = "okay";
            debug-level = <1>;
            recovery-timeout-ms = <1000>;
            ack-required;
          };
        };
      };
    }; 
```

## Documentation/devicetree/bindings/sound/pamir-ai-i2c-sound.yaml
```yaml
# SPDX-License-Identifier: (GPL-2.0-only OR BSD-2-Clause)
%YAML 1.2
---
$id: http://devicetree.org/schemas/sound/pamir-ai-i2c-sound.yaml#
$schema: http://devicetree.org/meta-schemas/core.yaml#

title: Pamir AI I2C Sound Device Tree Bindings

maintainers:
  - Utsav Balar <utsavbalar1231@gmail.com>

description: |
  This binding describes the Pamir AI I2C sound driver which interfaces with
  the TLV320AIC3204 audio codec via I2C. The driver provides volume control,
  input gain adjustment, and direct register access functionality.

properties:
  compatible:
    const: pamir-ai,i2c-sound

  reg:
    maxItems: 1
    description: I2C device address (typically 0x18)

  status:
    enum:
      - okay
      - disabled

required:
  - compatible
  - reg
  - status

additionalProperties: false

examples:
  - |
    &i2c_arm {
      status = "okay";
      
      pamir_ai_sound: pamir-ai-i2c-sound@18 {
        reg = <0x18>;
        compatible = "pamir-ai,i2c-sound";
        status = "okay";
      };
    }; 
```

## Documentation/devicetree/bindings/sound/pamir-ai-soundcard.yaml
```yaml
# SPDX-License-Identifier: (GPL-2.0-only OR BSD-2-Clause)
%YAML 1.2
---
$id: http://devicetree.org/schemas/sound/pamir-ai-soundcard.yaml#
$schema: http://devicetree.org/meta-schemas/core.yaml#

title: Pamir AI Sound Card Device Tree Bindings

maintainers:
  - Utsav Balar <utsavbalar1231@gmail.com>

description: |
  This binding describes the Pamir AI sound card solution which consists of
  a dummy sound card and an I2C-connected TLV320AIC3204 audio codec.

properties:
  compatible:
    enum:
      - pamir-ai,dummy_soundcard
      - pamir-ai,soundcard

  "#sound-dai-cells":
    const: 0
    description: Number of DAI cells, should be 0

  i2s-controller:
    $ref: /schemas/types.yaml#/definitions/phandle
    description: phandle to the I2S controller

  status:
    enum:
      - okay
      - disabled

required:
  - compatible
  - status

additionalProperties: false

examples:
  - |
    / {
      pamir-ai-soundcard {
        #sound-dai-cells = <0>;
        compatible = "pamir-ai,dummy_soundcard";
        status = "okay";
      };
    };

    &sound {
      compatible = "pamir-ai,soundcard";
      i2s-controller = <&i2s_clk_producer>;
      status = "okay";
    }; 
```

## drivers/misc/pamir-ai-sam/Kconfig
```kconfig
config PAMIR_AI_SAM_MODULE
	tristate "Pamir AI Sensor and Actuator Module (SAM) driver"
	depends on SERIAL_DEV_BUS
	help
	  Say Y here to support Pamir AI's Sensor and Actuator Module (SAM)
	  for communication between the host processor and RP2040 microcontroller.
	  
	  This driver interfaces with hardware components on the CM5 device,
	  specifically handling button inputs and RGB LED control via UART.
	  
	  To compile this driver as a module, choose M here: the module
	  will be called pamir-ai-sam. 
```
